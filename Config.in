## Config.in
```kconfig
source "$BR2_EXTERNAL_EROSQ_PATH/package/libldac/Config.in"
source "$BR2_EXTERNAL_EROSQ_PATH/package/libtinyalsa/Config.in"
source "$BR2_EXTERNAL_EROSQ_PATH/package/erosq-ui/Config.in"
source "$BR2_EXTERNAL_EROSQ_PATH/package/mpdctl/Config.in"
source "$BR2_EXTERNAL_EROSQ_PATH/package/erosq-splash/Config.in"
source "$BR2_EXTERNAL_EROSQ_PATH/package/erosq-board/Config.in"
```

## package/erosq-board/Config.in
```kconfig
config BR2_PACKAGE_EROSQ_BOARD
	bool "erosq-board"
	# erosq-ui runs "mpdctl stop" before an update
	select BR2_PACKAGE_MPDCTL
	# S90erosq-ui / erosq-uilaunch fall back to /sbin/erosq-splash
	select BR2_PACKAGE_EROSQ_SPLASH
	# /lib/firmware/regulatory.db{,.p7s} for cfg80211
	select BR2_PACKAGE_WIRELESS_REGDB
	help
	  EROS Q board support: the WiFi/BT chip firmware (extracted
	  from the stock firmware at build time), the device bring-up
	  scripts (bt_*, wifi_*), and the boot splash image (the
	  erosq-splash binary comes from package/erosq-splash).

if BR2_PACKAGE_EROSQ_BOARD

config BR2_PACKAGE_EROSQ_BOARD_STOCK_FW
	string "stock firmware for the WiFi/BT chip blobs"
	help
	  The CYW43438 WiFi firmware, its NVRAM and the BT patchram are
	  not redistributable, so they are taken from the stock EROS Q
	  firmware at build time: the stock update file
	  update_erosQ_v2.2-rbuninstall.upt, its SYSTEM.UBI, or an
	  extracted stock rootfs directory. A .upt or SYSTEM.UBI needs
	  ubi_reader on the host (pip install ubi_reader).

	  Empty = the first *.upt in $(BR2_EXTERNAL_EROSQ_PATH)/stock/
	  (gitignored). The build stops if none is found or the files
	  don't match the pinned sha256 sums.

config BR2_PACKAGE_EROSQ_BOARD_SWU_PUBKEY
	string "swupdate public key (self-signed builds)"
	help
	  PEM public key installed as /etc/swupdate/public.pem; the
	  device only installs .swu bundles signed by the matching
	  private key (see docs/fw-update-artifacts/mk-erosq-swu.sh
	  --key).

	  Empty = the project's official release key, so the image
	  accepts official releases only.

config BR2_PACKAGE_EROSQ_BOARD_SEED_AUTHORIZED_KEYS
	string "root SSH keys to seed on first boot (private builds)"
	help
	  Path to an authorized_keys file kept OUTSIDE this repository
	  (or under the gitignored private/ directory). It is installed
	  as /usr/share/erosq/seed-authorized_keys, and on boot
	  erosq-ssh-seed copies it ONCE to /data/root/.ssh/authorized_keys
	  if that file does not exist yet, so an update cannot lock out
	  SSH. Leave empty for public builds: nothing is seeded.

endif
```

## package/erosq-firmware/Config.in
```kconfig
config BR2_PACKAGE_EROSQ_FIRMWARE
	bool "erosq-firmware (stock Wi-Fi/BT chip firmware)"
	default y
	help
	  The EROS Q stock v2.2 CYW43438 Wi-Fi firmware, its NVRAM and
	  the BT patchram, unmodified, from the erosq-cfw/erosq-firmware
	  repository at FIRMWARE_SHA (pins.mk). erosq-board installs
	  them after checking every file against its pinned sha256.

	  A stock image set in BR2_PACKAGE_EROSQ_BOARD_STOCK_FW (or in
	  stock/) takes precedence. With neither, the image ships no
	  chip firmware: Wi-Fi and Bluetooth do not work.
```

## package/erosq-splash/Config.in
```kconfig
config BR2_PACKAGE_EROSQ_SPLASH
	bool "erosq-splash"
	help
	  Fallback boot splash: loads a 320x240 RGB565 image (argv[1],
	  default /etc/splash.raw) into a DRM dumb buffer on
	  /dev/dri/card0, sets the mode and holds it until killed. No
	  libdrm. erosq-uilaunch execs it when erosq-ui fails to start.
	  Installs /sbin/erosq-splash.
```

## package/erosq-ui/Config.in
```kconfig
config BR2_PACKAGE_EROSQ_UI
	bool "erosq-ui"
	select BR2_PACKAGE_LIBDRM
	select BR2_PACKAGE_LIBTINYALSA
	help
	  EROS Q LVGL front-end (menu/wheel/battery/WiFi/BT/audio UI).
	  LVGL is fetched at the pinned release; links Buildroot libdrm (shared) and
	  the pinned libtinyalsa 1.1.1 (static).
```

## package/libldac/Config.in
```kconfig
config BR2_PACKAGE_LIBLDAC
	bool "libldac"
	help
	  Sony LDAC Bluetooth A2DP encoder (libldacBT). Built from the
	  EROS Q vendored ldacBT source.
```

## package/libtinyalsa/Config.in
```kconfig
config BR2_PACKAGE_LIBTINYALSA
	bool "libtinyalsa"
	help
	  tinyalsa 1.1.1 (pinned). The on-device 2.x release cannot set the
	  EROS Q ES9018K2M 2-value volume control, so this stays at 1.1.1.
	  Static library, consumed by erosq-ui.
```

## package/mpdctl/Config.in
```kconfig
config BR2_PACKAGE_MPDCTL
	bool "mpdctl"
	help
	  Minimal MPD client over the AF_UNIX socket (/run/mpd.sock, or
	  $MPD_HOST_SOCK). Each argument is sent as one MPD command,
	  then "close"; the reply is copied to stdout. Used by erosq-ui
	  ("mpdctl stop" before an update). Installs /usr/bin/mpdctl.
```
